/**
 *    This code was generated by JSTP CodeGen version 1.11.0.26193
 *
 *    Generate info:
 *        Date      : 12.12.2017 12:12
 *        User      : voloshkevich
 *        Domain    : NPORTS
 *  Paths:
 *
 *      ======== Генератор для дрона ========
 *      gen: DroneGen 1.0.0
 *        gen.info : Описание устройства
 *        gen.reset : Сброс настроек частоты и мощности
 *        gen.set : Установить частоту и мощность
 *        gen.get : Показать частоту и мощность
 *        gen.set_freq : Установить частоту
 *        gen.get_freq : Считать частоту в Гц
 *        gen.set_pow : Установить мощность
 *        gen.get_pow : Считать мощность (от 001 до 511) 8,5 единиц ~ 1 дБм
*/

#include "jstp_gen.h"
#include "hal.h"

#define SOFT_VERSION "v1.0.0-3-g769d42c"
#define HARD_VERSION "v1.0.0"


//======================================================================
//
//                  Генератор для дрона
//
//======================================================================

/**
 * gen.info
 * Описание устройства
 * Arg      : NULL
 * Result   : DeviceCard
 */
static int jstp_gen_info(char *path_str, char* arg_str, jsmntok_t *arg_tokens, size_t args_token_count)
{
    // ======= BEGIN ARGS =======
   // Null

    // ======= END ARGS =======


    // ======= BEGIN RESULT =======
    jstp_tx_begin();                // <- {"OK":

    // DeviceCard
    jstp_tx_obj_begin();            // <- {
    jstp_tx_obj_key("name");        // <- key
    jstp_tx_str("Drone lab generator");            // <- value
    jstp_tx_obj_end_item();            // end prop

    jstp_tx_obj_key("sv");        // <- key
    jstp_tx_str(SOFT_VERSION);            // <- value
    jstp_tx_obj_end_item();            // end prop

    jstp_tx_obj_key("hv");        // <- key
    jstp_tx_str(HARD_VERSION);            // <- value
    jstp_tx_obj_end();
    jstp_tx_end();        // <- }\n
    return JSTP_NO_ERROR; // <- SUCCESS
    // ======= END RESULT =======



}

/**
 * gen.reset
 * Сброс настроек частоты и мощности
 * Arg      : NULL
 * Result   : Bool
 */
static int jstp_gen_reset(char *path_str, char* arg_str, jsmntok_t *arg_tokens, size_t args_token_count)
{
    // ======= BEGIN ARGS =======
   // Null

    // ======= END ARGS =======

    hal_set_freq(0);
    hal_set_pow(0);

    // ======= BEGIN RESULT =======
    jstp_tx_begin();                // <- {"OK":
    jstp_tx_bool(true);        // <- Bool
    jstp_tx_end();        // <- }\n
    return JSTP_NO_ERROR; // <- SUCCESS
    // ======= END RESULT =======



}

/**
 * gen.set
 * Установить частоту и мощность
 * Arg      : FreqPowParams
 * Result   : FreqPowParams
 */
static int jstp_gen_set(char *path_str, char* arg_str, jsmntok_t *arg_tokens, size_t args_token_count)
{
    // ======= BEGIN ARGS =======

    // FreqPowParams
    size_t size;
    if (!jstp_rx_obj(arg_str,arg_tokens++,&size)) return JSTP_ARGS_ERROR;
    while(size--)
    {
        // FreqPowParams.freq
        if (jstp_rx_cmp_str(arg_str,arg_tokens,"freq"))
        {

            long intArg;
            if (!jstp_rx_long(arg_str,++arg_tokens,&intArg)) return JSTP_ARGS_ERROR;
            hal_set_freq(intArg);

        }
        // FreqPowParams.pow
        else if (jstp_rx_cmp_str(arg_str,arg_tokens,"pow"))
        {

            long intArg;
            if (!jstp_rx_long(arg_str,++arg_tokens,&intArg)) return JSTP_ARGS_ERROR;
            hal_set_pow(intArg);

        }
        else return JSTP_ARGS_ERROR;
        arg_tokens++;
    }

    // ======= END ARGS =======


    // ======= BEGIN RESULT =======
    jstp_tx_begin();                // <- {"OK":

    // FreqPowParams
    jstp_tx_obj_begin();            // <- {
    jstp_tx_obj_key("freq");        // <- key
    jstp_tx_long(hal_get_freq());            // <- value
    jstp_tx_obj_end_item();            // end prop

    jstp_tx_obj_key("pow");        // <- key
    jstp_tx_long(hal_get_pow());            // <- value
    jstp_tx_obj_end();
    jstp_tx_end();        // <- }\n
    return JSTP_NO_ERROR; // <- SUCCESS
    // ======= END RESULT =======



}

/**
 * gen.get
 * Показать частоту и мощность
 * Arg      : NULL
 * Result   : FreqPowParams
 */
static int jstp_gen_get(char *path_str, char* arg_str, jsmntok_t *arg_tokens, size_t args_token_count)
{
    // ======= BEGIN ARGS =======
    // Null

    // ======= END ARGS =======


    // ======= BEGIN RESULT =======
    jstp_tx_begin();                // <- {"OK":

    // FreqPowParams
    jstp_tx_obj_begin();            // <- {
    jstp_tx_obj_key("freq");        // <- key
    jstp_tx_long(hal_get_freq());   // <- value
    jstp_tx_obj_end_item();         // end prop

    jstp_tx_obj_key("pow");         // <- key
    jstp_tx_long(hal_get_pow());    // <- value

    jstp_tx_obj_end();
    jstp_tx_end();        // <- }\n
    return JSTP_NO_ERROR; // <- SUCCESS
    // ======= END RESULT =======



}

/**
 * gen.set_freq
 * Установить частоту
 * Arg      : Integer
 * Result   : Integer
 */
static int jstp_gen_set_freq(char *path_str, char* arg_str, jsmntok_t *arg_tokens, size_t args_token_count)
{
    // ======= BEGIN ARGS =======

    long longArg;
    if (!jstp_rx_long(arg_str,arg_tokens,&longArg)) return JSTP_ARGS_ERROR;

    // ======= END ARGS =======

    hal_set_freq(longArg);

    // ======= BEGIN RESULT =======
    jstp_tx_begin();                // <- {"OK":
    jstp_tx_long(hal_get_freq());        // <- Integer
    jstp_tx_end();        // <- }\n
    return JSTP_NO_ERROR; // <- SUCCESS
    // ======= END RESULT =======



}

/**
 * gen.get_freq
 * Считать частоту в Гц
 * Arg      : NULL
 * Result   : Integer
 */
static int jstp_gen_get_freq(char *path_str, char* arg_str, jsmntok_t *arg_tokens, size_t args_token_count)
{
    // ======= BEGIN ARGS =======
   // Null

    // ======= END ARGS =======


    // ======= BEGIN RESULT =======
    jstp_tx_begin();                // <- {"OK":
    jstp_tx_long(hal_get_freq());        // <- Integer
    jstp_tx_end();        // <- }\n
    return JSTP_NO_ERROR; // <- SUCCESS
    // ======= END RESULT =======



}

/**
 * gen.set_pow
 * Установить мощность
 * Arg      : Integer
 * Result   : Integer
 */
static int jstp_gen_set_pow(char *path_str, char* arg_str, jsmntok_t *arg_tokens, size_t args_token_count)
{
    // ======= BEGIN ARGS =======

    long longArg;
    if (!jstp_rx_long(arg_str,arg_tokens,&longArg)) return JSTP_ARGS_ERROR;

    // ======= END ARGS =======

    hal_set_pow(longArg);

    // ======= BEGIN RESULT =======
    jstp_tx_begin();                    // <- {"OK":
    jstp_tx_long(hal_get_pow());         // <- Integer
    jstp_tx_end();                      // <- }\n
    return JSTP_NO_ERROR;               // <- SUCCESS
    // ======= END RESULT =======



}

/**
 * gen.get_pow
 * Считать мощность (от 001 до 511) 8,5 единиц ~ 1 дБм
 * Arg      : NULL
 * Result   : Integer
 */
static int jstp_gen_get_pow(char *path_str, char* arg_str, jsmntok_t *arg_tokens, size_t args_token_count)
{
    // ======= BEGIN ARGS =======
   // Null

    // ======= END ARGS =======


    // ======= BEGIN RESULT =======
    jstp_tx_begin();                    // <- {"OK":
    jstp_tx_long(hal_get_pow());         // <- Integer
    jstp_tx_end();        // <- }\n
    return JSTP_NO_ERROR; // <- SUCCESS
    // ======= END RESULT =======



}



static int jstp__root_path(char *path_str, char* arg_str, jsmntok_t *arg_tokens, size_t args_token_count)
{
    jstp_tx_begin();
    jstp_tx_array_begin();
    jstp_tx_str("gen");

    jstp_tx_array_end();
    jstp_tx_end();
    return JSTP_NO_ERROR;
}


/**
 * gen : DroneGen 1.0.0
 * Генератор для дрона
 */

static int jstp_gen(char *path_str, char* arg_str, jsmntok_t *arg_tokens, size_t args_token_count)
{
    jstp_tx_begin();
    jstp_tx_str("DroneGen 1.0.0");
    jstp_tx_end();
    return JSTP_NO_ERROR;
}


int jstp_execute_gen(char *path_str, char* arg_str, jsmntok_t *arg_tokens, size_t args_token_count)
{
    if (jstp_str_compare(path_str,""))
    {
        return jstp__root_path(path_str,arg_str,arg_tokens,args_token_count);
    }


    if (jstp_str_compare(path_str,"gen"))
    {
        return jstp_gen(path_str,arg_str,arg_tokens,args_token_count);
    }
    if (jstp_str_compare(path_str,"gen.info"))
    {
        return jstp_gen_info(path_str,arg_str,arg_tokens,args_token_count);
    }

    if (jstp_str_compare(path_str,"gen.reset"))
    {
        return jstp_gen_reset(path_str,arg_str,arg_tokens,args_token_count);
    }

    if (jstp_str_compare(path_str,"gen.set"))
    {
        return jstp_gen_set(path_str,arg_str,arg_tokens,args_token_count);
    }

    if (jstp_str_compare(path_str,"gen.get"))
    {
        return jstp_gen_get(path_str,arg_str,arg_tokens,args_token_count);
    }

    if (jstp_str_compare(path_str,"gen.set_freq"))
    {
        return jstp_gen_set_freq(path_str,arg_str,arg_tokens,args_token_count);
    }

    if (jstp_str_compare(path_str,"gen.get_freq"))
    {
        return jstp_gen_get_freq(path_str,arg_str,arg_tokens,args_token_count);
    }

    if (jstp_str_compare(path_str,"gen.set_pow"))
    {
        return jstp_gen_set_pow(path_str,arg_str,arg_tokens,args_token_count);
    }

    if (jstp_str_compare(path_str,"gen.get_pow"))
    {
        return jstp_gen_get_pow(path_str,arg_str,arg_tokens,args_token_count);
    }



    return JSTP_PATH_NOT_FOUND;
}




